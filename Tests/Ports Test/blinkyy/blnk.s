	AREA MYDATA, DATA, READONLY
RCC_BASE		EQU		0x40021000
RCC_APB2ENR		EQU		RCC_BASE + 0x18
	
	
GPIOC_BASE		EQU		0x40011000
GPIOC_CRL		EQU		GPIOC_BASE + 0x00
GPIOC_CRH		EQU		GPIOC_BASE + 0x04
GPIOC_ODR		EQU		GPIOC_BASE + 0x0C
GPIOC_BSRR		EQU		GPIOC_BASE	+ 0x010
GPIOC_BRR		EQU		GPIOC_BASE	+ 0x014
		

INTERVAL		EQU		0xB00000
		
		
	AREA MYCODE, CODE, READONLY
		
	EXPORT __main

		
		
__main	FUNCTION
	
	
	BL CONFIGURE_PORT_C
MAINLOOP	
	BL LED_HIGH
	BL DELAY_ONE_SECOND
	
	BL LED_LOW
	BL DELAY_ONE_SECOND

	B MAINLOOP
	
	
	
	ENDFUNC
	

CONFIGURE_PORT_C	FUNCTION
	PUSH{R0-R12, LR}
	
	;PUT 1 IN FRONT OF IOPCEN IN RCC_APB2ENR
	LDR R0, =RCC_APB2ENR
	LDR R1, [R0]
	MOV R2, #1
	ORR R1, R1, R2, LSL #4
	STR R1, [R0]
	
	
	LDR R0, =GPIOC_CRH	;CHOOSE PC13 AS OUTPUT
	LDR R1, [R0]
	MOV R2, #0xFF0FFFFF		;RESET THE 4 BITS OF PIN13
	AND R1, R1, R2
	MOV R2, #0x00300000		;00 IN CNF, AND 11 IN MODE OF PIN13 (WRITE USEFUL DATA)
	ORR R1, R1, R2
	STR R2, [R0]
	
	
	
	POP{R0-R12, PC}
	ENDFUNC
	
	
LED_HIGH	FUNCTION
	PUSH{R0-R12, LR}
	
	;WHY WRITE LOW??? BCS THE LED IS ACTIVE LOW
	LDR R0, =GPIOC_ODR
	LDR R1, [R0]
	MOV R2, #1
	LSL R2, #13
	MVN R2, R2
	AND R1, R1, R2
	STR R1, [R0]
	
	POP{R0-R12, PC}
	ENDFUNC
	
	
LED_LOW	FUNCTION
	PUSH{R0-R12, LR}
	
	
	LDR R0, =GPIOC_ODR
	LDR R1, [R0]
	MOV R2, #1
	ORR R1, R1, R2, LSL #13
	STR R1, [R0]
	
	POP{R0-R12, PC}
	ENDFUNC
	
	
	

DELAY_ONE_SECOND	FUNCTION
	PUSH{R0-R12, LR}
	LDR R0, =INTERVAL
DELAY_1_LOOP
	SUBS R0, R0, #1
	CMP R0, #0
	BGT DELAY_1_LOOP
	
	POP{R0-R12, PC}
	ENDFUNC
	
	
	
	END